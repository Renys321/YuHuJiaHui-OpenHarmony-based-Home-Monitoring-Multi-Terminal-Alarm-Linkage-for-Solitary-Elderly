## evidence/2026-10-26-local-alarm-voice-closure/source-before/Kconfig.projbuild
```kconfig
menu "居家安全监护 · ESP32-S3 无线节点"

    config NODE_VOICE_ENABLED
        bool "ES8388 local voice candidate (DNESP32S3, requires free I2S pins)"
        default n
        help
            Playback only. Uses GPIO3/9/10/46 and I2C0 GPIO41/42.
            Frozen kitchen MQ5 wiring uses GPIO9. Kitchen voice revision moves
            its protected ADC signal to GPIO7 (ADC1_CH6); rewire before deployment.
            Also isolates local sensing from WiFi/gateway reconnects.

    config NODE_VOICE_VOLUME
        int "Speaker analog volume (0..20, cautious initial setting)"
        depends on NODE_VOICE_ENABLED
        range 0 20
        default 15

    config NODE_VOICE_BOOT_TEST
        bool "Speak diagnostic test once at boot (no alarm generated)"
        depends on NODE_VOICE_ENABLED
        default n

    config NODE_WIFI_SSID
        string "WiFi 名称 (SSID)"
        default "YOUR_WIFI"
        help
            节点所在房间的 WiFi 名称（2.4GHz）。

    config NODE_WIFI_PASS
        string "WiFi 密码"
        default "YOUR_PASSWORD"

    config NODE_ID
        string "设备编号 deviceId"
        default "esp32-bathroom"
        help
            上报报文里的设备编号，决定云端主题 home/<deviceId>/status。
            同一套系统内必须唯一，建议形如 esp32-卫生间 的拼音/英文。

    config NODE_ROOM
        string "房间名称 room"
        default "卫生间"
        help
            上报给北向 APP 展示的房间名。

    config NODE_GW_HOST
        string "网关地址（PC 上桥接程序所在主机）"
        default "192.168.1.100"
        help
            桥接程序 mqtt_bridge.js 监听的主机 IP。
            注意：ESP32 只需连到这个网关，不需要自己实现 MQTT。

    config NODE_GW_PORT
        int "网关端口"
        default 9100
        help
            桥接程序 --listen 的端口。

    config NODE_MOTION_GPIO
        int "人体传感器 GPIO"
        default 4
        help
            红外人体传感器输入脚（高电平=有人）。接 -1 表示不使用。

    config NODE_MOTION_DEBOUNCE_CONFIRM
        int "PIR 连续确认次数（消抖）"
        default 2
        range 1 10

    config NODE_SOS_GPIO
        int "SOS 按键 GPIO（内部上拉，低电平按下；-1 禁用）"
        default -1
        help
            按键另一端接 GND，按下为低电平。建议用仅输入脚（如 IO35/IO36/IO37）。

    config NODE_SOS_DEBOUNCE_CONFIRM
        int "SOS 按下连续确认次数（消抖）"
        default 2
        range 1 10

    config NODE_WATER_GPIO
        int "水漏传感器 DO GPIO（-1 禁用）"
        default -1
        help
            水漏模块数字输出，必须确认输出电平 <= 3.3V 后才能接入。

    config NODE_WATER_ACTIVE_LOW
        bool "水漏 DO 低电平=湿润"
        default y

    config NODE_WATER_CONFIRM_COUNT
        int "水漏连续湿润确认次数"
        default 3
        range 1 20

    config NODE_WATER_CLEAR_COUNT
        int "水漏连续干燥确认次数（重新武装）"
        default 3
        range 1 20

    config NODE_DOOR_GPIO
        int "门窗磁 GPIO"
        default 5
        help
            门窗磁输入脚（高电平=开启）。接 -1 表示不使用。

    config NODE_BUZZER_XL9555
        bool "使用板载蜂鸣器（XL9555 P0_3，正点原子 DNESP32S3）"
        default n
        help
            板载蜂鸣器不在 GPIO 上，而由 I2C IO 扩展芯片 XL9555 的 P0_3 控制
            （官方 BSP：components/BSP/XL9555/xl9555.h -> BEEP_IO=0x0008）。
            启用后 NODE_BUZZER_GPIO 应设为 -1。

    config NODE_BUZZER_GPIO
        int "蜂鸣器 GPIO"
        default 6
        help
            有源蜂鸣器输出脚（高电平鸣响）。接 -1 表示不使用。

    config NODE_AHT20_ENABLED
        bool "启用 AHT20 温湿度传感器"
        default n

    config NODE_DHT11_GPIO
        int "DHT11 DATA GPIO（-1 禁用；与 AHT20 二选一）"
        default -1
        help
            DHT11 单总线数据脚，模块 VCC 3.3V、DATA 需 4.7k~10k 上拉到 3.3V。
            启用时不要同时启用 AHT20；默认 -1，保持旧节点行为不变。

    config NODE_DHT11_BENCH
        bool "DHT11 连续 5 次离线自检（仅 bench 诊断）"
        default n
        help
            仅供离线 bench：启动后在 WiFi 之前连续读取 5 次并打印结果；生产配置保持 n。

    config NODE_LOCAL_BENCH
        bool "本地 PIR/SOS bench（跳过 WiFi/网关）"
        default n
        help
            仅供离线 bench：跳过 WiFi/网关，持续轮询 PIR/SOS 并打印原始电平/事件；
            不发送 MQTT，不注册设备。生产配置保持 n。

    config NODE_I2C_SDA_GPIO
        int "AHT20 SDA GPIO"
        default 11
        depends on NODE_AHT20_ENABLED

    config NODE_I2C_SCL_GPIO
        int "AHT20 SCL GPIO"
        default 12
        depends on NODE_AHT20_ENABLED

    config NODE_MQ2_ADC_CHANNEL
        int "MQ-2 ADC1 通道（GPIO1=0；-1 禁用）"
        default -1
        range -1 9
        help
            厨房已验收接线为 GPIO6 / ADC1_CH5。MQ 模块 AO 必须先限压或分压到 ESP32-S3 ADC 安全范围。

    config NODE_MQ5_ADC_CHANNEL
        int "MQ-5 ADC1 通道（GPIO2=1；-1 禁用）"
        default -1
        range -1 9
        help
            厨房原冻结接线 GPIO9 / ADC1_CH8，与板载音频冲突。
            厨房语音候选改为 GPIO7 / ADC1_CH6，必须同步迁移实物信号线。
            MQ 模块 AO 必须先限压或分压到 ESP32-S3 ADC 安全范围。

    config NODE_MQ2_ALARM_RAW
        int "MQ-2 烟雾报警原始阈值（4096=校准前禁用）"
        default 4096
        range 0 4096

    config NODE_MQ5_ALARM_RAW
        int "MQ-5 燃气报警原始阈值（4096=校准前禁用）"
        default 4096
        range 0 4096

    config NODE_MQ_CONFIRM_COUNT
        int "MQ 连续确认次数（触发/解除都需要连续 N 次）"
        default 3
        range 1 10

    config NODE_MQ_HYSTERESIS_RAW
        int "MQ 回差（raw）：解除告警需低于 阈值-回差"
        default 20
        range 0 1024

    config NODE_ALARM_BEEP_SEC
        int "告警鸣响时长（秒，0=一直响直到 ACK/reset）"
        default 10
        range 0 600
        help
            告警触发后蜂鸣器鸣响的时长；到时自动静音，但告警状态仍然保留（需 ACK/reset 才回 NORMAL）。
            设 0 表示一直响（旧行为）。

    config NODE_BOOT_BEEP_MS
        int "上电自检短鸣时长(ms，0=不鸣)"
        default 0
        range 0 2000
        help
            仅用于一次性验证蜂鸣器控制；量产/验收后必须保持 0，避免每次开机鸣响。

    config NODE_TEMP_LOW_C
        int "低温阈值（摄氏度）"
        default 10

    config NODE_TEMP_HIGH_C
        int "高温阈值（摄氏度）"
        default 30

    config NODE_RH_LOW
        int "低湿阈值（百分比）"
        default 25
        range 0 100

    config NODE_RH_HIGH
        int "高湿阈值（百分比）"
        default 75
        range 0 100

    config NODE_REPORT_SEC
        int "上报周期（秒）"
        default 5

    config NODE_NO_MOTION_SEC
        int "无活动告警阈值（秒）"
        default 1800
        help
            超过该时长没有检测到人体活动即触发告警（演示时可调小到 30）。

endmenu
```
